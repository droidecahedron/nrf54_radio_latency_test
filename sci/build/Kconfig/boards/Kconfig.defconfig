## sci/build/Kconfig/boards/Kconfig.defconfig
```kconfig
# Load Zephyr board defconfig descriptions.
osource "/home/nrf-ddhd/ncs/v3.2.1/zephyr/boards/nordic/nrf54l15dk/Kconfig.defconfig"
```

## sci/build/Kconfig/boards/Kconfig.sysbuild
```kconfig
# Load Sysbuild board Kconfig descriptions.
osource "/home/nrf-ddhd/ncs/v3.2.1/zephyr/boards/nordic/nrf54l15dk/Kconfig.sysbuild"
```
